#include <behaviors.dtsi>
#include <dt-bindings/zmk/keys.h>
#include <dt-bindings/zmk/bt.h>

/ {
    // The hold-tap behaviors the keymap may use:
    // - mt_  holds a key (a modifier, or a plain key such as F17), taps a key
    // - lt_  holds a layer, taps a key
    // - omt_ holds a modifier, one-shots it on tap
    // - olt_ holds a layer, one-shots it on tap
    // mt_ and lt_ come in the flavors the keymap can pick between: tp
    // (tap-preferred, the default, used on the home-row) and hp
    // (hold-preferred, used on the thumb keys). One-shot keys are always
    // tap-preferred, so that a quick tap always one-shots.
    //
    // hold-preferred takes the hold as soon as any other key goes down, which
    // is what makes a thumb layer engage without waiting, and also what made it
    // engage mid-word on a thumb key pressed inside a burst of typing. The hp
    // pair therefore refuses to hold at all within require-prior-idle-ms of the
    // last key press, so a thumb key only shifts a layer once typing has
    // actually paused, and quick-tap-ms keeps a repeated tap a tap.
    behaviors {
        mt_tp: mod_tap_tap_preferred {
            compatible = "zmk,behavior-hold-tap";
            #binding-cells = <2>;
            flavor = "tap-preferred";
            tapping-term-ms = <200>;
            bindings = <&kp>, <&kp>;
        };
        mt_hp: mod_tap_hold_preferred {
            compatible = "zmk,behavior-hold-tap";
            #binding-cells = <2>;
            flavor = "hold-preferred";
            tapping-term-ms = <200>;
            quick-tap-ms = <200>;
            require-prior-idle-ms = <150>;
            bindings = <&kp>, <&kp>;
        };

        lt_tp: layer_tap_tap_preferred {
            compatible = "zmk,behavior-hold-tap";
            #binding-cells = <2>;
            flavor = "tap-preferred";
            tapping-term-ms = <200>;
            bindings = <&mo>, <&kp>;
        };
        lt_hp: layer_tap_hold_preferred {
            compatible = "zmk,behavior-hold-tap";
            #binding-cells = <2>;
            flavor = "hold-preferred";
            tapping-term-ms = <200>;
            quick-tap-ms = <200>;
            require-prior-idle-ms = <150>;
            bindings = <&mo>, <&kp>;
        };

        omt_: oneshot_mod_tap {
            compatible = "zmk,behavior-hold-tap";
            #binding-cells = <2>;
            flavor = "tap-preferred";
            tapping-term-ms = <200>;
            bindings = <&kp>, <&sk>;
        };
        olt_: oneshot_layer_tap {
            compatible = "zmk,behavior-hold-tap";
            #binding-cells = <2>;
            flavor = "tap-preferred";
            tapping-term-ms = <200>;
            bindings = <&mo>, <&sl>;
        };
    };

    // App and OS layer keys send F18 or F19 together with another key. Neither
    // function key is a modifier, so this holds both until the key is released
    // and then lets the key up before the function key. A second chord of the
    // same function key started before the first is released can drop it early;
    // the layers are used one key at a time.
    macros {
        fn_key: fn_key {
            compatible = "zmk,behavior-macro-two-param";
            #binding-cells = <2>;
            wait-ms = <15>;
            tap-ms = <0>;
            bindings
                = <&macro_param_1to1>
                , <&macro_press &kp MACRO_PLACEHOLDER>
                , <&macro_param_2to1>
                , <&macro_press &kp MACRO_PLACEHOLDER>
                , <&macro_pause_for_release>
                , <&macro_param_2to1>
                , <&macro_release &kp MACRO_PLACEHOLDER>
                , <&macro_param_1to1>
                , <&macro_release &kp MACRO_PLACEHOLDER>
                ;
        };
    };

    keymap {
            compatible = "zmk,keymap";

            default_layer {
                    display-name = "Base";
                    bindings = <
#LAYER_0#
                    >;
            };

            raise_layer {
                    display-name = "Nav/Num";
                    bindings = <
#LAYER_1#
                    >;
            };

            lower_layer {
                    display-name = "Symbols";
                    bindings = <
#LAYER_2#
                    >;
            };

            hyper_layer {
                    display-name = "Hyper";
                    bindings = <
#LAYER_3#
                    >;
            };

            adjust_layer {
                    display-name = "Adj";
                    bindings = <
#LAYER_4#
                    >;
            };

            mouse_layer {
                    display-name = "Mou";
                    bindings = <
#LAYER_5#
                    >;
            };

            app_layer {
                    display-name = "App";
                    bindings = <
#LAYER_6#
                    >;
            };

            os_layer {
                    display-name = "OS";
                    bindings = <
#LAYER_7#
                    >;
            };
        };
#COMBOS#
};
