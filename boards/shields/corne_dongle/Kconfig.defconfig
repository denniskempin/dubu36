## boards/shields/corne_dongle/Kconfig.defconfig
```kconfig
# Copyright (c) 2026 Dennis Kempin
# SPDX-License-Identifier: MIT

if SHIELD_CORNE_DONGLE

config ZMK_KEYBOARD_NAME
    default "Dubu36Travel"

config ZMK_SPLIT_ROLE_CENTRAL
    default y

config ZMK_SPLIT
    default y

config ZMK_SPLIT_BLE_CENTRAL_PERIPHERALS
    default 2

config BT_MAX_CONN
    default 7

config BT_MAX_PAIRED
    default 7

endif
```

## boards/shields/dubu36e/Kconfig.defconfig
```kconfig
if SHIELD_DUBU36E_LEFT

config ZMK_KEYBOARD_NAME
    default "Dubu36ergo"

config ZMK_SPLIT_ROLE_CENTRAL
    default y

endif

if SHIELD_DUBU36E_LEFT || SHIELD_DUBU36E_RIGHT

config ZMK_SPLIT
    default y

endif

if SHIELD_DUBU36E_DONGLE

config ZMK_KEYBOARD_NAME
    default "Dubu36ergo"

config ZMK_SPLIT_ROLE_CENTRAL
    default y

config ZMK_SPLIT
    default y

config ZMK_SPLIT_BLE_CENTRAL_PERIPHERALS
    default 2

config BT_MAX_CONN
    default 7

config BT_MAX_PAIRED
    default 7

endif
```

## boards/shields/dubu36e/Kconfig.shield
```kconfig
# Copyright (c) 2023 Dennis Kempin
# SPDX-License-Identifier: MIT

config SHIELD_DUBU36E_LEFT
    def_bool $(shields_list_contains,dubu36e_left)

config SHIELD_DUBU36E_RIGHT
    def_bool $(shields_list_contains,dubu36e_right)

config SHIELD_DUBU36E_DONGLE
    def_bool $(shields_list_contains,dubu36e_dongle)
```

## dts/bindings/behaviors/zmk,behavior-instant-hold.yaml
```yaml
# Copyright (c) 2026 Dennis Kempin
# SPDX-License-Identifier: MIT

description: |
  Hold key that is pressed the moment the binding goes down. A release inside
  tapping-term-ms releases the hold key and then taps the second parameter.
  A longer press leaves the hold key down until release.

  The first parameter is the hold keycode and the second is the tap keycode.
  Both are forwarded to the behaviors in `bindings`, which are key-press
  behaviors without their own parameters.

compatible: "zmk,behavior-instant-hold"

include: two_param.yaml

properties:
  bindings:
    type: phandles
    required: true
  tapping-term-ms:
    type: int
    required: true
```
